## drivers/csi/3rdparty/usbdpfp/Kconfig
```kconfig
config DPFINGERPRINT
       tristate "Build Digital Persona's USB Finger Print driver"
       depends on m
       help
         This builds the Digital Personas USB Finger print driver. Driver
         is named usbdpfp.ko
```

## drivers/csi/digitalio/Kconfig
```kconfig
config DIGITALIO
       tristate "Build Digital I/O module"
       depends on m
       select GPIO_MCP23S08
       help
         This builds the Digital I/O module, named digitalio.ko. The
         digitalio module sits uppon mcp23s08.ko module, register its gpio
         and provide a simpler interface for working with it.
```

## drivers/csi/powerfailure/Kconfig
```kconfig
config POWERFAILURE
       tristate "Build Power Failure module"
       depends on m
       help
         This builds the Power Failure module, named
         powerfailure.ko. The Power Failure module is in charge to
         detect that main power supply is out and brings a clean shutdown.
         
```
